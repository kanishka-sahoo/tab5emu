## components/controller_manager/Kconfig
```kconfig
menu "Controller manager"

    config RETRO_USB_PADS
        bool "USB Xbox pads (deferred to v2)"
        default n
        help
            Start the USB host on USB-A and the xinput_host class driver for
            wired Xbox 360 / One / Series pads (plan D11). USB controllers
            are deferred to v2; v1 input is the touch screen only. The
            driver is kept building so v2 can switch it on.

endmenu
```

## components/emulator_manager/Kconfig
```kconfig
menu "Emulator frontend"

    config RETRO_DEVMODE
        bool "Developer mode (performance overlay, CPU load)"
        default y
        select FREERTOS_GENERATE_RUN_TIME_STATS
        help
            Performance overlay (spec §45) with per-core CPU load, which
            needs FreeRTOS run-time statistics. Turned off for release
            builds (plan Phase 8).

    config RETRO_DEVMODE_OVERLAY_AT_BOOT
        bool "Show the performance overlay at boot"
        depends on RETRO_DEVMODE
        default y

    menu "Audio"
        config RETRO_AUDIO_RATE
            int "Output sample rate (Hz)"
            default 48000

        config RETRO_AUDIO_PERIOD_FRAMES
            int "Frames per I2S DMA buffer"
            range 64 1024
            default 240

        config RETRO_AUDIO_PERIODS
            int "I2S DMA buffers"
            range 2 16
            default 4
            help
                DMA latency = buffers x frames. 4 x 240 at 48 kHz = 20 ms
                (the BSP default was 6 x 240 = 30 ms).

        config RETRO_AUDIO_LATENCY_MS
            int "Ring buffer high-water mark (ms)"
            range 10 100
            default 24
            help
                The emulator blocks when the ring holds more than this
                (plan D3). Total output latency is roughly this minus half a
                frame of audio, plus the DMA queue: ~36 ms by default
                (spec §15 target: < 40 ms).
    endmenu

    menu "Task layout (plan §3.2)"
        config RETRO_TASK_EMU_CORE
            int "Emulator task core"
            range 0 1
            default 0
        config RETRO_TASK_EMU_PRIO
            int "Emulator task priority"
            default 20
        config RETRO_TASK_AUDIO_CORE
            int "audio_out task core"
            range 0 1
            default 1
        config RETRO_TASK_AUDIO_PRIO
            int "audio_out task priority"
            default 22
        config RETRO_TASK_VIDEO_CORE
            int "video_out task core"
            range 0 1
            default 1
        config RETRO_TASK_VIDEO_PRIO
            int "video_out task priority"
            default 18
        config RETRO_TASK_INPUT_CORE
            int "Input tasks core (touch; USB pads in v2)"
            range 0 1
            default 1
        config RETRO_TASK_INPUT_PRIO
            int "Touch task priority"
            default 18
        config RETRO_TASK_USB_PRIO
            int "USB pad client task priority (v2)"
            depends on RETRO_USB_PADS
            default 15
        config RETRO_TASK_MONITOR_PRIO
            int "Statistics task priority"
            default 4
    endmenu

endmenu
```

## components/hwtest/Kconfig
```kconfig
menu "Hardware test (hwtest)"

    config RETRO_HWTEST_BOOT
        bool "Boot into the hardware test"
        default n
        help
            Start the Phase 1 bring-up tests instead of the Phase 2
            pipeline test (synthetic core). Later this becomes Recovery ->
            "Test hardware".

    config RETRO_HWTEST_AUTORUN
        bool "Run the automatic tests at boot"
        depends on RETRO_HWTEST_BOOT
        default y
        help
            Runs "all" once at boot: board, display, PPA, SD, audio, power,
            RTC, then starts the USB host. Plays short test tones.

endmenu
```

## components/retro_hal/Kconfig
```kconfig
menu "Retro HAL"

    config RETRO_LOG_RING_SIZE
        int "In-RAM log ring size (bytes)"
        range 1024 262144
        default 16384
        help
            Size of the circular log kept in internal RAM for the recovery
            log viewer (spec §46).

    config RETRO_LOG_DEFAULT_LEVEL
        int "Default log level (0=none 1=error 2=warn 3=info 4=debug 5=verbose)"
        range 0 5
        default 3

    config RETRO_LOG_CAPTURE_IDF
        bool "Capture ESP-IDF log output in the in-RAM ring"
        default y
        help
            Tee ESP_LOGx output (drivers, BSP) into the log ring so recovery
            mode shows it alongside RetroHAL messages.

    config RETRO_TAB5_SHUNT_MOHM
        int "Tab5 battery shunt resistor (milliohm)"
        range 1 1000
        default 5
        help
            Shunt on the INA226 battery monitor. M5Unified uses 5 mOhm for
            the Tab5.

    config RETRO_TAB5_DISPLAY_60HZ
        bool "Retime the Tab5 panel to 60 Hz"
        default y
        help
            The BSP's ST7123/ST7121 timings refresh at 57.5 Hz (bring-up),
            which drops ~2.6 frames a second of 60 Hz content. This shortens
            the vertical front porch so the panel runs at 60.0 Hz. The
            original ILI9881C panel keeps the BSP timing.

    config RETRO_TAB5_TOUCH_I2C_KHZ
        int "ST712x touch I2C clock (kHz)"
        range 100 400
        default 400
        help
            Clock for reading the ST7123/ST7121 touch controller directly.
            Falls back to 100 kHz if the controller doesn't answer.

    choice RETRO_TAB5_LANDSCAPE
        prompt "Tab5 landscape orientation"
        default RETRO_TAB5_LANDSCAPE_CW
        help
            The panel scans out in portrait (720x1280, plan D2). This picks
            which way landscape content is rotated onto it. CW puts the top
            of the landscape image on the panel's native right edge.

        config RETRO_TAB5_LANDSCAPE_CW
            bool "Rotate 90 degrees clockwise"
        config RETRO_TAB5_LANDSCAPE_CCW
            bool "Rotate 90 degrees counter-clockwise"
    endchoice

endmenu
```
